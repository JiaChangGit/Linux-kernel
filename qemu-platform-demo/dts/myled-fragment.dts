/*
 * myled-fragment.dts
 *
 * 這個 fragment 會合併到 QEMU ARM64 virt machine 的 DTB。
 * myled-controller 固定放在 MMIO 0x0d000000，名稱也固定為
 * myled-controller@0d000000，避免測試腳本和 driver 彼此漂移。
 *
 * 屬性用途：
 *   - compatible  : 觸發 driver 的 OF match
 *   - reg         : MMIO base + size，probe 時會再次檢查
 *   - num-leds    : 自訂 u32 屬性
 *   - label       : 自訂字串屬性
 *   - default-brightness : 開機預設亮度
 *   - status      : "okay" 啟用節點
 */

/dts-v1/;

/* 這個 fragment 透過 fdtoverlay 合併到 QEMU 產生的 base DTB。 */
/plugin/;

/ {
    fragment@0 {
        target-path = "/";

        __overlay__ {
            #address-cells = <2>;
            #size-cells = <2>;

            /*
            * myled platform device。
            * MMIO 固定為 0x0d000000，大小 0x1000，必須和 driver 常數一致。
            */
            myled: myled-controller@0d000000 {

                /* Driver binding key，必須和 of_match_table 相符。 */
                compatible = "myvendor,myled-v1";
                myvendor,simulated;

                /*
                * 實體 MMIO 範圍：[base address, size]。
                * 這個位址由 dts/patch_dtb.sh 先對 QEMU base DTB 做 overlap 檢查。
                */
                reg = <0x0 0x0d000000 0x0 0x1000>;

                /* LED 數量。 */
                num-leds = <4>;

                /* 人類可讀 label，probe 時會印出方便比對。 */
                label = "demo-rgb-led";

                /* 開機預設亮度，driver 端會 clamp 到 0..255。 */
                default-brightness = <180>;

                /* 啟用裝置。 */
                status = "okay";
            };
        };
    };
};
